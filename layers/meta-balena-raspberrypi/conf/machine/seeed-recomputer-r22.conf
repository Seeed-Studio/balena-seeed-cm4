## layers/meta-balena-raspberrypi/conf/machine/seeed-recomputer-r22.conf
```bitbake
#@TYPE: Machine
#@NAME: Seeed reComputer-R22
#@SOC: broadcom bcm2712
#@DESCRIPTION: Machine configuration for seeed reComputer-R22
#@MAINTAINER: ruiqian tang <ruiqian.tang@seeed.cc>

MACHINEOVERRIDES = "raspberrypi5:${MACHINE}"
include conf/machine/raspberrypi5.conf

# Boot partition files configuration - use balena-bootloader like raspberrypi5
BALENA_BOOT_PARTITION_FILES:remove = " \
    u-boot.bin:/${SDIMG_KERNELIMAGE} \
    boot.scr:/boot.scr \
    "

BALENA_BOOT_PARTITION_FILES:append = " \
    balena-bootloader/${KERNEL_IMAGETYPE}-initramfs-${MACHINE}.bin:/${SDIMG_KERNELIMAGE} \
    balena-bootloader/bootenv:/bootenv \
    "

# Enable balena-bootloader build for this machine
PREFERRED_PROVIDER_virtual/balena-bootloader = "linux-balena-bootloader"

# Dependencies for balena-bootloader and grub-editenv
IMAGE_INSTALL:append = " grub-editenv userlandtools hailo-firmware"

# Hostapp update hooks configuration
HOSTAPP_HOOKS:remove = "99-resin-uboot 999-resin-boot-cleaner"
HOSTAPP_HOOKS:append = " 99-balena-bootloader"

# Add kernel device tree overlays from kernel source
RPI_KERNEL_DEVICETREE_OVERLAYS:append = " overlays/i2c0.dtbo \ 
overlays/i2c1.dtbo overlays/i2c3.dtbo overlays/i2c6.dtbo"

# Add device tree overlays from seeed-linux-dtoverlays package to boot partition
BALENA_BOOT_PARTITION_FILES:append = " reComputer-R22.dtbo:/overlays/reComputer-R22.dtbo"
KERNEL_MODULE_AUTOLOAD:rpi += "i2c-dev"
MACHINE_ESSENTIAL_EXTRA_RRECOMMENDS += "seeed-linux-dtoverlays"

# Ensure seeed-linux-dtoverlays is deployed before balena-image build
do_resin_boot_dirgen_and_deploy[depends] += "seeed-linux-dtoverlays:do_deploy"
ENABLE_UART = "1"

# Override userlandtools compatibility for this machine
COMPATIBLE_MACHINE:pn-userlandtools = "seeed-recomputer-r22"
```

## layers/meta-balena-raspberrypi/conf/machine/seeed-rerouter-cm4.conf
```bitbake
#@TYPE: Machine
#@NAME: Seeed reRouter CM4 Board
#@DESCRIPTION: Machine configuration for the Dual Gigabit Ethernet Carrier Board 
#for RPi CM4 in 64 bits mode

MACHINEOVERRIDES =. "raspberrypi4-64:${MACHINE}"
include conf/machine/raspberrypi4-64.conf
```

## layers/meta-balena-seeed-cm4/conf/machine/seeed-recomputer-r110x.conf
```bitbake
#@TYPE: Machine
#@NAME: Seeed reComputer-R110x
#@SOC: broadcom bcm2711
#@DESCRIPTION: Machine configuration for seeed reComputer-R110x
#@MAINTAINER: ruiqian tang <ruiqian.tang@seeed.cc>

MACHINEOVERRIDES = "raspberrypi4-64:${MACHINE}"
include conf/machine/raspberrypi4-64.conf

RPI_KERNEL_DEVICETREE_OVERLAYS:append = " overlays/reComputer-R110x.dtbo overlays/i2c0.dtbo \ 
overlays/i2c1.dtbo overlays/i2c3.dtbo overlays/i2c5.dtbo"
KERNEL_MODULE_AUTOLOAD:rpi += "i2c-dev"
ENABLE_I2C = "1"
ENABLE_UART = "1"
```
